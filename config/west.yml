## config/west.yml
```yaml
manifest:
  remotes:
    - name: zmkfirmware
      url-base: https://github.com/zmkfirmware
    - name: nicekeyboards
      url-base: https://github.com/nicekeyboards
    # Additional modules containing boards/shields/custom code can be listed here as well
    # See https://docs.zephyrproject.org/3.2.0/develop/west/manifest.html#projects
  projects:
    - name: zmk
      remote: zmkfirmware
      revision: main
      import: app/west.yml
    - name: zmk-nice-nano
      remote: nicekeyboards
      revision: main
      path: modules/zephyr/zmk-nice-nano
  self:
    path: config
```
